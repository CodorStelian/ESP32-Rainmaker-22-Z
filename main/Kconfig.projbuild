## main/Kconfig.projbuild
```kconfig
menu "Example Configuration"

    config APP_LED_GPIO
        int "RGB LED GPIO"
        default 15
        help
            Set the WS2812 RGB LED GPIO.
	config I2CDEV_TIMEOUT
		int "I2C transaction timeout, milliseconds"
		default 1000
		range 100 5000

endmenu
```

## sdkconfig.defaults
```kconfig
CONFIG_ESPTOOLPY_FLASHFREQ_80M=y
CONFIG_ESPTOOLPY_FLASHSIZE_4MB=y
CONFIG_PARTITION_TABLE_SINGLE_APP=
CONFIG_PARTITION_TABLE_TWO_OTA=
CONFIG_PARTITION_TABLE_CUSTOM=y
CONFIG_PARTITION_TABLE_CUSTOM_FILENAME="partitions.csv"
CONFIG_PARTITION_TABLE_FILENAME="partitions.csv"
CONFIG_PARTITION_TABLE_OFFSET=0x8000
CONFIG_PARTITION_TABLE_MD5=y
CONFIG_ESP_RMAKER_MAX_NODE_CONFIG_SIZE=4096
CONFIG_ESP32_DEFAULT_CPU_FREQ_240=y
CONFIG_ESP_RMAKER_DEF_TIMEZONE="Europe/Bucharest"

# mbedtls
CONFIG_MBEDTLS_DYNAMIC_BUFFER=y
CONFIG_MBEDTLS_DYNAMIC_FREE_PEER_CERT=y
CONFIG_MBEDTLS_DYNAMIC_FREE_CONFIG_DATA=y

# For BLE Provisioning using NimBLE stack (ESP32 only)
CONFIG_BT_ENABLED=y
CONFIG_BTDM_CTRL_MODE_BLE_ONLY=y
CONFIG_BT_NIMBLE_ENABLED=y
```
